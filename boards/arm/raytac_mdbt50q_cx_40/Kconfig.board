## boards/arm/raytac_mdbt50q_cx_40/Kconfig.board
```kconfig
config BOARD_RAYTAC_MDBT50Q_CX_40
	bool "Raytac MDBT50Q-CX-40 USB Dongle"
	depends on SOC_NRF52840_QIAA
```

## boards/arm/raytac_mdbt50q_cx_40/Kconfig.defconfig
```kconfig
if BOARD_RAYTAC_MDBT50Q_CX_40

config BOARD
	default "raytac_mdbt50q_cx_40"

# Nordic Open DFU bootloader
config FLASH_LOAD_OFFSET
	default 0x1000
	depends on BOARD_HAS_NRF5_BOOTLOADER

endif
```

## boards/arm/xiao_nrf52840/Kconfig.board
```kconfig
config BOARD_XIAO_NRF52840
	bool "Seeed XIAO nRF52840"
	depends on SOC_NRF52840_QIAA
```

## boards/arm/xiao_nrf52840/xiao_nrf52840_defconfig
```kconfig
CONFIG_SOC_SERIES_NRF52X=y
CONFIG_SOC_NRF52840_QIAA=y
CONFIG_BOARD_XIAO_NRF52840=y

# Enable MPU and stack protection
CONFIG_ARM_MPU=y
CONFIG_HW_STACK_PROTECTION=y

# Enable GPIO
CONFIG_GPIO=y

# XIAO has external 32kHz crystal
CONFIG_CLOCK_CONTROL_NRF_K32SRC_XTAL=y

# Use on-chip BLE controller with SoftDevice Link Layer
CONFIG_BT_CTLR=y
CONFIG_BT_LL_SOFTDEVICE=y

# Enable PWM for RC outputs
CONFIG_PWM=y
```
